## cbpm-dongle/build-dongle/cbpm-dongle/Kconfig/Kconfig.shield
```kconfig
osource "/Users/momo/Desktop/Code/cbpm-firmware/boards/shields/*/Kconfig.shield"
osource "/opt/nordic/ncs/v3.1.0/nrf/boards/shields/*/Kconfig.shield"
```

## cbpm-dongle/build-dongle/cbpm-dongle/Kconfig/Kconfig.shield.defconfig
```kconfig
osource "/Users/momo/Desktop/Code/cbpm-firmware/boards/shields/*/Kconfig.defconfig"
osource "/opt/nordic/ncs/v3.1.0/nrf/boards/shields/*/Kconfig.defconfig"
```

## cbpm-dongle/build-dongle/cbpm-dongle/Kconfig/boards/Kconfig.defconfig
```kconfig
# Load Zephyr board defconfig descriptions.
osource "/opt/nordic/ncs/v3.1.0/zephyr/boards/seeed/xiao_ble/Kconfig.defconfig"
```
