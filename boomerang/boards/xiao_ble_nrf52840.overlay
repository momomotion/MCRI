/*
 * Copyright (c) 2026 MCRI. All rights reserved.
 *
 * SPDX-License-Identifier: LicenseRef-Proprietary
 *
 * This software is the confidential and proprietary information of
 * MCRI. It must not be used, copied, redistributed or disclosed
 * without prior written authorisation.
 */

/*
 * Devicetree overlay for board target xiao_ble/nrf52840.
 *
 * HOW THIS FILE IS FOUND. Zephyr looks for boards/<board target with slashes
 * turned into underscores>.overlay next to your CMakeLists.txt and applies it
 * on top of the board's own devicetree. Nothing references it by name -- match
 * the filename to the board and it is picked up. Check the build log for
 * "Found devicetree overlay" if you are not sure it landed.
 *
 * WHAT DEVICETREE IS FOR. It describes the hardware that exists: which
 * peripherals are enabled, which pins they use, how fast they run. Kconfig
 * (prj.conf) decides which software is compiled. A common beginner's hour is
 * lost by setting a Kconfig option for a peripheral whose devicetree node is
 * still disabled, or the reverse.
 *
 * WHAT WE ARE CHANGING AND WHY. Almost nothing, because the stock Seeed board
 * already gets this right:
 *
 *   - uart0 (UARTE0) is already enabled on P1.11 (TX, pad D6) and P1.12 (RX,
 *     pad D7), which is the same pair the Roo V5 carrier uses for its Joey
 *     link. Convenient, and not a coincidence: both are XIAO modules.
 *   - The stock pin control already sets bias-pull-up on the RX pin. Leave it.
 *     A floating RX line on an idle link is read as a stream of break
 *     conditions and framing errors, which on the sibling Roo board produced a
 *     genuine error storm before the far end started driving the wire.
 *   - cdc_acm_uart0 already exists (the board includes Zephyr's common
 *     cdc_acm_serial.dtsi), so the USB data port needs no declaration here.
 *
 * That leaves the one thing the contract fixes and the board cannot know: the
 * link to Roo runs at 1 Mbaud, and the dongle does not translate rates.
 */

&uart0 {
	/*
	 * 1 Mbaud, matching the Roo link (docs/contract.md, MODE_UART).
	 *
	 * Milestone note: while you are bringing the bridge up in M3 against a
	 * loopback jumper, any rate works, and 115200 is easier to eyeball on a
	 * scope or a logic analyser. Change the number here, rebuild, and
	 * remember to change your host tool to match -- both ends of a UART have
	 * to agree, and nothing tells you when they do not except garbage.
	 */
	current-speed = <1000000>;
};

/*
 * A note on what is deliberately NOT here.
 *
 * The XIAO ships with the Adafruit UF2 bootloader, and the board devicetree
 * therefore places the application at flash offset 0x27000 rather than 0. You
 * do not need to do anything about that -- but it is why `west flash --erase`
 * is forbidden on this board (it would erase the bootloader and the UICR along
 * with your image). scripts/flash.sh refuses the flag.
 *
 * If this firmware is ever promoted from a learning exercise to the real
 * dongle, the next step is a proper board definition of its own under
 * boards/mcri/dongle/, in the shape of the Roo V5 board root. That is a
 * bigger, more careful job than an overlay, and it is the right time to do it,
 * not now.
 */
